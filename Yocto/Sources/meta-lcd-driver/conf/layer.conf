## Yocto/Sources/meta-lcd-driver/conf/layer.conf
```bitbake
# We have a conf and classes directory, add to BBPATH
BBPATH .= ":${LAYERDIR}"

# We have recipes-* directories, add to BBFILES
BBFILES += "${LAYERDIR}/recipes-*/*/*.bb \
            ${LAYERDIR}/recipes-*/*/*.bbappend"

BBFILE_COLLECTIONS += "meta-lcd-driver"
BBFILE_PATTERN_meta-lcd-driver = "^${LAYERDIR}/"
BBFILE_PRIORITY_meta-lcd-driver = "6"

LAYERDEPENDS_meta-lcd-driver = "core"
LAYERSERIES_COMPAT_meta-lcd-driver = "kirkstone"
```

## Yocto/build/conf/bblayers.conf
```bitbake
# POKY_BBLAYERS_CONF_VERSION is increased each time build/conf/bblayers.conf
# changes incompatibly
POKY_BBLAYERS_CONF_VERSION = "2"

BBPATH = "${TOPDIR}"
BBFILES ?= ""

BBLAYERS ?= " \
  /home/hardik/Desktop/AESD_FINAL_PROJECT/final-project-HardikMinochaESE/Yocto/Sources/poky/meta \
  /home/hardik/Desktop/AESD_FINAL_PROJECT/final-project-HardikMinochaESE/Yocto/Sources/poky/meta-poky \
  /home/hardik/Desktop/AESD_FINAL_PROJECT/final-project-HardikMinochaESE/Yocto/Sources/poky/meta-yocto-bsp \
  ${TOPDIR}/../Sources/meta-raspberrypi \
  ${TOPDIR}/../Sources/meta-openembedded/meta-oe \
  ${TOPDIR}/../Sources/meta-openembedded/meta-multimedia \
  ${TOPDIR}/../Sources/meta-openembedded/meta-networking \
  ${TOPDIR}/../Sources/meta-openembedded/meta-python \
  ${TOPDIR}/../Sources/meta-lcd-driver \
  "
```
